## boards/shields/torabo_tsuki_lp/Kconfig.defconfig
```kconfig
if SHIELD_TORABO_TSUKI_LP_LEFT || SHIELD_TORABO_TSUKI_LP_RIGHT

config ZMK_KEYBOARD_NAME
    default "torabo-tsuki"

config ZMK_SPLIT
    default y

config SPI
    default y

config INPUT
    default y

config ZMK_MOUSE
    default y
 # 💡 左側のビルド（SHIELD_TORABO_TSUKI_LP_LEFT）の時だけ、スクロール機能をONにするマクロ
if SHIELD_TORABO_TSUKI_LP_LEFT
config TORABO_TSUKI_LP_SCROLL_ENABLE
    bool
    default y
endif
endif
```

## config/west.yml
```yaml
manifest:
  remotes:
    - name: sekigon-gonnoc
      url-base: https://github.com/sekigon-gonnoc
    - name: cormoran
      url-base: https://github.com

  projects:
    - name: zmk
      remote: cormoran
      revision: v0.3-branch+dya
      import: app/west.yml
    - name: zmk-component-bmp-boost
      remote: sekigon-gonnoc
      revision: main
    - name: zmk-feature-status-led
      remote: sekigon-gonnoc
      revision: main
    - name: zmk-driver-paw3222
      remote: sekigon-gonnoc
      revision: main
    - name: zmk-driver-iqs7211e
      remote: sekigon-gonnoc
      revision: master
    - name: zmk-feature-cdc-acm-bootloader-trigger
      remote: sekigon-gonnoc
      revision: main
    - name: zmk-feature-non-lipo-battery-management
      remote: sekigon-gonnoc
      revision: main
    - name: zmk-module-runtime-input-processor
      remote: cormoran
      revision: main
```
