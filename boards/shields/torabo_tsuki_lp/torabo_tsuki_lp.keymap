
#include "../../../config/keymap.keymap"
/* ========================================================================== */
/* 💡 右側トラックボール：特定レイヤーでのスクロール変換設定                  */
/* ========================================================================== */

/* 1. 通常のマウス移動ルールをレイヤー0, 1, 2の時だけに制限する */
&trackball_listener_normal {
    layers = <0 1 2>; 
};

/* 2. 右側にある元のトラックボール設定（&trackball_listener）へスクロール設定を追加 */
&trackball_listener {
    scroll_layer {
        compatible = "zmk,input-processor-layer-overrides";
        layers = <3>; /* 👈 3番のレイヤー（SCROLLレイヤー）にいるときだけ発動 */
        input-processors = <&zip_xy_to_scroll_mapper>;
    };
};
/* ========================================================================== */
